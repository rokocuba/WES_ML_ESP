## components/digit_inference/Kconfig.projbuild
```kconfig
menu "Digit Inference"

config DIGIT_INFERENCE_TENSOR_ARENA_SIZE
    int "Tensor arena size (bytes)"
    range 16384 262144
    default 98304
    help
        Tensor arena used by TensorFlow Lite Micro. Increase this value if
        AllocateTensors fails at runtime.

config DIGIT_INFERENCE_ARENA_IN_SPIRAM
    bool "Try PSRAM for tensor arena"
    default y
    help
        If enabled, the inference component first tries to place the tensor
        arena in PSRAM. It falls back to internal RAM if PSRAM allocation fails.

config DIGIT_INFERENCE_PERF_LOGS
    bool "Enable preprocessing/inference performance logs"
    default y
    help
        If enabled, the component logs decode, preprocess, and inference timing
        plus heap snapshots (internal, PSRAM, and total 8-bit) for capacity
        planning when sharing resources with camera pipelines.

endmenu
```
